## drivers/misc/mediatek-consys/Kconfig
```kconfig
# SPDX-License-Identifier: GPL-2.0
config MTK_CONSYS
	bool "MediaTek MT6582 on-SoC connectivity subsystem (WMT/STP over BTIF)"
	depends on ARCH_MEDIATEK || COMPILE_TEST
	depends on OF
	help
	  The MT6572/MT6582 family carries its Bluetooth/WiFi/FM/GPS radios on
	  the SoC ("CONSYS"), reached through the BTIF link with MediaTek's
	  WMT (management) and STP (transport) protocol stack, ported here from
	  the vendor GPL kernel.

config MTK_CONSYS_BT
	bool "Bluetooth over CONSYS STP (hci driver for BlueZ)"
	depends on MTK_CONSYS && BT
	help
	  A kernel hci device on the STP Bluetooth channel, so BlueZ sees an
	  ordinary hci0.

config MTK_CONSYS_BT_CHRDEV
	bool "The vendor /dev/stpbt char device as well"
	depends on MTK_CONSYS
	help
	  The Android-style raw H4 char device (for a userspace HCI attach or
	  bring-up tests). Exclusive with the hci driver: the STP Bluetooth
	  channel has one consumer, so bring hci0 down before using it.

config MTK_CONSYS_WIFI
	bool "MT6582 full-MAC WiFi over the CONSYS AHB HIF"
	depends on MTK_CONSYS && CFG80211
	help
	  Build the MT6582 vendor full-MAC station driver, ported to the
	  current cfg80211 API. The radio firmware is managed through WMT and
	  packets use the SoC's dedicated AHB HIF at 0x180f0000.
```

## drivers/soc/mediatek/Kconfig
```kconfig
# SPDX-License-Identifier: GPL-2.0-only
#
# MediaTek SoC drivers
#
menu "MediaTek SoC drivers"
	depends on ARCH_MEDIATEK || COMPILE_TEST

config MTK_CMDQ
	tristate "MediaTek CMDQ Support"
	depends on ARCH_MEDIATEK || COMPILE_TEST
	select MAILBOX
	select MTK_CMDQ_MBOX
	select MTK_INFRACFG
	help
	  Say yes here to add support for the MediaTek Command Queue (CMDQ)
	  driver. The CMDQ is used to help read/write registers with critical
	  time limitation, such as updating display configuration during the
	  vblank.

config MTK_DEVAPC
	tristate "Mediatek Device APC Support"
	help
	  Say yes here to enable support for Mediatek Device APC driver.
	  This driver is mainly used to handle the violation which catches
	  unexpected transaction.
	  The violation information is logged for further analysis or
	  countermeasures.

config MTK_INFRACFG
	bool "MediaTek INFRACFG Support"
	select REGMAP
	help
	  Say yes here to add support for the MediaTek INFRACFG controller. The
	  INFRACFG controller contains various infrastructure registers not
	  directly associated to any device.

config MTK_PMIC_WRAP
	tristate "MediaTek PMIC Wrapper Support"
	depends on RESET_CONTROLLER
	depends on OF
	select REGMAP
	help
	  Say yes here to add support for MediaTek PMIC Wrapper found
	  on different MediaTek SoCs. The PMIC wrapper is a proprietary
	  hardware to connect the PMIC.

config MTK_REGULATOR_COUPLER
	bool "MediaTek SoC Regulator Coupler" if COMPILE_TEST
	default ARCH_MEDIATEK
	depends on REGULATOR

config MTK_MMSYS
	tristate "MediaTek MMSYS Support"
	default ARCH_MEDIATEK
	depends on HAS_IOMEM
	depends on MTK_CMDQ || MTK_CMDQ=n
	help
	  Say yes here to add support for the MediaTek Multimedia
	  Subsystem (MMSYS).

config MTK_SVS
	tristate "MediaTek Smart Voltage Scaling(SVS)"
	depends on NVMEM_MTK_EFUSE && NVMEM
	help
	  The Smart Voltage Scaling(SVS) engine is a piece of hardware
	  which has several controllers(banks) for calculating suitable
	  voltage to different power domains(CPU/GPU/CCI) according to
	  chip process corner, temperatures and other factors. Then DVFS
	  driver could apply SVS bank voltage to PMIC/Buck.

config MTK_SOCINFO
	tristate "MediaTek SoC Information"
	default y
	depends on NVMEM_MTK_EFUSE
	select SOC_BUS
	help
	  The MediaTek SoC Information (mtk-socinfo) driver provides
	  information about the SoC to the userspace including the
	  manufacturer name, marketing name and soc name.

config MTK_MT6582_MFG_POWER
	bool "MediaTek MT6582 MFG (Mali-400 GPU) power domain"
	depends on PM_GENERIC_DOMAINS
	depends on ARCH_MEDIATEK || COMPILE_TEST
	help
	  Minimal genpd provider that runs the MT6582 MFG MTCMOS power-up
	  sequence and ungates the GPU clock gate, so the lima driver can drive
	  the on-SoC Mali-400 MP2. There is no full MT6582 SCPSYS/clock driver;
	  the clock source is left as the bootloader configured it.

config MTK_MT6582_SPM
	bool "MediaTek MT6582 system power manager"
	depends on ARCH_MEDIATEK || COMPILE_TEST
	help
	  Bring up the MT6582 system power manager (SPM) and run the vendor
	  normal-mode PCM program. The normal program services the always-on
	  source-clock and thermal handshakes used by SoC subsystems. Suspend
	  and deep-idle modes are not implemented yet.

	  If unsure, say N.

endmenu
```
